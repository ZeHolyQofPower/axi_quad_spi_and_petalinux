/include/ "system-conf.dtsi"
/ {
};
//&spi1 {
&axi_quad_spi_0 {
	status = "okay";
//	spidev@0x0 {
//		compatible = "linux,spidev";
//		reg = <0x0>;
//		spi-max-frequency = <0x3938700>;	// 60MHz
//	};
	#address-cells = <0x1>;
	#size-cells = <0x0>;
	flash@0 {
		compatible = "linux,spidev";
		reg = <0x0>;
		spi-max-frequency = <0x3938700>;	// 60MHz
		#address-cells = <0x1>;
		#size-cells = <0x1>;
		partition@test {
			label = "spi-flash";
			reg = <0x0 0x800000>;	// magic lol
		};
Kernel command line: console=ttyPS0,115200 earlycon root=/dev/mmcblk0p2 rw rootwait

	};
};
